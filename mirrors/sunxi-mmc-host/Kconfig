## mirrors/sunxi-mmc-host/Kconfig
```kconfig
menuconfig MMC_SUNXI
        tristate "Allwinner sunxi SD/MMC Host Controller support"
        depends on ARCH_SUNXI
        help
          This selects support for the SD/MMC Host Controller on
          Allwinner sunxi SoCs.

config MMC_SUNXI_V4P1X
        bool "V4P1X sunxi SD/MMC Host Controller support"
        depends on MMC_SUNXI
        default y
        help
          V4P1X sunxi SD/MMC Host Contrller support.

config MMC_SUNXI_V4P00X
        bool "V4P00X sunxi SD/MMC Host Controller support"
        depends on MMC_SUNXI
        default y
        help
          V4P00X sunxi SD/MMC Host Contrller support.

config MMC_SUNXI_V4P5X
        bool "V4P5X sunxi SD/MMC Host Controller support"
        depends on MMC_SUNXI
        default y
        help
          V4P5X sunxi SD/MMC Host Contrller support.

config MMC_SUNXI_V5P3X
        bool "V5P3X sunxi SD/MMC Host Controller support"
        depends on MMC_SUNXI
        default y
        help
          V5P3X sunxi SD/MMC Host Contrller support.
```
